## conf/layer.conf
```bitbake
# We have a conf and classes directory, add to BBPATH
BBPATH .= ":${LAYERDIR}"

# We have recipes-* directories, add to BBFILES
BBFILES += "${LAYERDIR}/recipes-*/*/*.bb \
            ${LAYERDIR}/recipes-*/*/*.bbappend"

BBFILE_COLLECTIONS += "nuvlabox-os"
BBFILE_PATTERN_nuvlabox-os = "^${LAYERDIR}/"
BBFILE_PRIORITY_nuvlabox-os = "6"

LAYERDEPENDS_nuvlabox-os = "core"
LAYERSERIES_COMPAT_nuvlabox-os = "warrior zeus"
```

## meta-nuvlabox-common/conf/layer.conf
```bitbake
# We have a conf and classes directory, add to BBPATH
BBPATH .= ":${LAYERDIR}"

# We have recipes-* directories, add to BBFILES
BBFILES += "${LAYERDIR}/recipes-*/*/*.bb \
            ${LAYERDIR}/recipes-*/*/*.bbappend"

BBFILE_COLLECTIONS += "nuvlabox-common"
BBFILE_PATTERN_nuvlabox-common = "^${LAYERDIR}/"
BBFILE_PRIORITY_nuvlabox-common = "6"

LAYERDEPENDS_nuvlabox-common = "core"
LAYERSERIES_COMPAT_nuvlabox-common = "warrior zeus dunfell"
```
